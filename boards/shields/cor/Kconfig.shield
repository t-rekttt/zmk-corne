## boards/shields/cor/Kconfig.shield
```kconfig
# Copyright (c) 2020 Pete Johanson
# SPDX-License-Identifier: MIT

config SHIELD_COR_LEFT
    def_bool $(shields_list_contains,cor_left)

config SHIELD_COR_RIGHT
    def_bool $(shields_list_contains,cor_right)
```
